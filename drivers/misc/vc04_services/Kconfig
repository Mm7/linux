## drivers/misc/vc04_services/Kconfig
```kconfig
config BCM2708_VCHIQ
	tristate "Videocore VCHIQ"
	depends on RASPBERRYPI_FIRMWARE
	default n
	help
		Kernel to VideoCore communication interface for the
		BCM2708 family of products.
		Defaults to Y when the Broadcom Videocore services
		are included in the build, N otherwise.
```
